#include "sputnik.dtsi"

&default_transform {
    col-offset = <6>;
};

&kscan0 {
    row-gpios
        = <&pro_micro 20 (GPIO_ACTIVE_HIGH | GPIO_PULL_DOWN)> // A2
        , <&pro_micro 15 (GPIO_ACTIVE_HIGH | GPIO_PULL_DOWN)> // D15
        , <&pro_micro 16 (GPIO_ACTIVE_HIGH | GPIO_PULL_DOWN)> // D16
        , <&pro_micro 10 (GPIO_ACTIVE_HIGH | GPIO_PULL_DOWN)> // D10
        ;

    col-gpios
        = <&pro_micro 3 GPIO_ACTIVE_HIGH>  // D3 (P0.20) <--- ТУТ БУЛО 9
        , <&pro_micro 8 GPIO_ACTIVE_HIGH>  // D8
        , <&pro_micro 7 GPIO_ACTIVE_HIGH>  // D7
        , <&pro_micro 6 GPIO_ACTIVE_HIGH>  // D6
        , <&pro_micro 5 GPIO_ACTIVE_HIGH>  // D5
        , <&pro_micro 4 GPIO_ACTIVE_HIGH>  // D4
        ;
};