#include "sputnik.dtsi"

&kscan0 {
    row-gpios
        = <&pro_micro 6 (GPIO_ACTIVE_HIGH | GPIO_PULL_DOWN)> // D6
        , <&pro_micro 7 (GPIO_ACTIVE_HIGH | GPIO_PULL_DOWN)> // D7
        , <&pro_micro 8 (GPIO_ACTIVE_HIGH | GPIO_PULL_DOWN)> // D8
        , <&pro_micro 9 (GPIO_ACTIVE_HIGH | GPIO_PULL_DOWN)> // D9 (P1.06) <-- ПОВЕРНУЛИ ЯК БУЛО
        ;

    col-gpios
        = <&pro_micro 19 GPIO_ACTIVE_HIGH> // A1 (Tab)
        , <&pro_micro 18 GPIO_ACTIVE_HIGH> // A0
        , <&pro_micro 15 GPIO_ACTIVE_HIGH> // D15
        , <&pro_micro 14 GPIO_ACTIVE_HIGH> // D14
        , <&pro_micro 16 GPIO_ACTIVE_HIGH> // D16
        , <&pro_micro 10 GPIO_ACTIVE_HIGH> // D10 (Inner)
        ;
};